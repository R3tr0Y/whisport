## firmware/main/Kconfig.projbuild
```kconfig
menu "Whisport"

    config WS_SERVER_URL
        string "服务器基础 URL"
        default "https://whisport.pages.dev"
        help
            Cloudflare Pages 部署地址（末尾不带斜杠）。pages.dev 域名国内可达；勿用 workers.dev。

    config WS_WIFI_SSID
        string "Wi-Fi SSID"
        default ""

    config WS_WIFI_PASS
        string "Wi-Fi 密码"
        default ""

endmenu
```
